## tests/fixtures/usb/main/Kconfig.projbuild
```kconfig
menu "USB lifecycle regression fixture"
    config USB_TEST_DIRECT
        bool "Application owns the TinyUSB task and descriptors"
        default n
endmenu
```
